## CMakeLists.txt
```
cmake_minimum_required(VERSION 3.20.0)

# Console baud, as a devicetree overlay generated before Zephyr reads the
# devicetree - which is why this block sits above find_package().
#
#   west build ... -- -DCTRL_CONSOLE_BAUD=921600
#
# The board .dts fixes usart3 at 115200, and that line is the trace transport:
# a 501-step run is ~31 KB of console output. Whether raising it helps is an
# empirical question - the bytes are being lost in a buffer, and a higher rate
# fills that buffer faster - so this exists to measure rather than to assume.
# 921600, not the board default of 115200. Measured 2026-09-06 over five
# captures per rate, and the result went the opposite way to the guess: faster
# is CLEANER, not noisier.
#
#   115200  0-2 rows lost, 0-3 damaged, 3.6 s
#   230400  0 lost,         0-1 damaged, 2.2 s
#   460800  0 lost,         0 damaged,   1.4 s
#   921600  0 lost,         0 damaged,   1.0 s
#
# The loss is a time-in-flight problem, not a rate problem: less wall-clock
# spent streaming means fewer windows in which the host can be late. 921600 is
# also the ceiling - macOS rejects every rate above it on this driver.
set(CTRL_CONSOLE_BAUD "921600" CACHE STRING "usart3 console baud rate")
configure_file(console-baud.overlay.in ${CMAKE_CURRENT_BINARY_DIR}/console-baud.overlay @ONLY)
list(APPEND EXTRA_DTC_OVERLAY_FILE ${CMAKE_CURRENT_BINARY_DIR}/console-baud.overlay)

# The link's devicetree, when -DCTRL_LINK=y asks for it. Above find_package()
# for the same reason the console overlay is: Zephyr reads the devicetree in
# there, so anything appended afterwards is appended too late and the only
# symptom is a missing alias much further down the build.
#
# INCLUDED from firmware/link rather than copied. The DMA stream numbers are a
# settled board fact and a second copy is a second place to get them wrong; the
# DTCM selection stays duplicated in boards/ because that really is one line.
if(CTRL_LINK)
  if(BOARD STREQUAL "nucleo_f767zi")
    set(LINK_UART "usart6")
  elseif(BOARD STREQUAL "mini_stm32h743")
    set(LINK_UART "usart1")
  else()
    message(FATAL_ERROR "ctrl: no link UART known for board '${BOARD}'")
  endif()

  # Applied here rather than left to the caller. Without it the build still
  # succeeds and CONFIG_UART_ASYNC_API is simply off, so uart_callback_set
  # fails at runtime on a board that looks correctly configured - which is the
  # kind of quiet wrong that costs an afternoon. ctrl_io_link.c refuses to
  # compile without it as the second half of the same guard.
  list(APPEND EXTRA_CONF_FILE ${CMAKE_CURRENT_LIST_DIR}/link.conf)

  set(CTRL_LINK_BAUD "6000000" CACHE STRING "link UART baud rate")
  set(LINK_BAUD ${CTRL_LINK_BAUD})
  configure_file(../link/link-baud.overlay.in
                 ${CMAKE_CURRENT_BINARY_DIR}/link-baud.overlay @ONLY)
  list(APPEND EXTRA_DTC_OVERLAY_FILE
       ${CMAKE_CURRENT_LIST_DIR}/../link/boards/${BOARD}-link.dtsi
       ${CMAKE_CURRENT_BINARY_DIR}/link-baud.overlay)
endif()

find_package(Zephyr REQUIRED HINTS $ENV{ZEPHYR_BASE})
project(ctrl_lab_control_runtime)

# Which committed fixture to embed and grade against.
#   west build ... -- -DCTRL_PLAN=02-feedback-TF
set(CTRL_PLAN "04-2nd-order-system" CACHE STRING "test-projects fixture to run")

set(CTRL_FIXTURES ${CMAKE_CURRENT_LIST_DIR}/../../test-projects)
set(CTRL_PLAN_FILE ${CTRL_FIXTURES}/${CTRL_PLAN}.plan.dcp)
set(CTRL_REF_FILE ${CTRL_FIXTURES}/${CTRL_PLAN}.f32.csv)

foreach(required ${CTRL_PLAN_FILE} ${CTRL_REF_FILE})
  if(NOT EXISTS ${required})
    message(FATAL_ERROR "CTRL_PLAN=${CTRL_PLAN}: missing ${required}")
  endif()
endforeach()

# Embed the plan as bytes. Reading the committed .dcp at configure time rather
# than checking in a generated header means the two can never drift apart.
file(READ ${CTRL_PLAN_FILE} CTRL_PLAN_HEX HEX)
string(REGEX REPLACE "(..)" "0x\\1, " CTRL_PLAN_BYTES ${CTRL_PLAN_HEX})

# The device runs exactly as many ticks as the reference trace has rows, so the
# two are comparable without the grader having to trim either.
file(STRINGS ${CTRL_REF_FILE} CTRL_REF_LINES)
list(LENGTH CTRL_REF_LINES CTRL_REF_COUNT)
math(EXPR CTRL_PLAN_STEPS "${CTRL_REF_COUNT} - 1")

configure_file(plan_blob.h.in ${CMAKE_CURRENT_BINARY_DIR}/include/plan_blob.h @ONLY)
message(STATUS "ctrl: plan ${CTRL_PLAN}, ${CTRL_PLAN_STEPS} steps, console ${CTRL_CONSOLE_BAUD} baud")

target_include_directories(app PRIVATE src ${CMAKE_CURRENT_BINARY_DIR}/include)
target_sources(app PRIVATE
  src/main.c
  src/dcp.c
  src/kernels.c
  src/runtime.c
  src/trace.c
)

# Bind the control core's Input/Output blocks to the MCU-to-MCU link:
#   west build ... -- -DCTRL_LINK=y -DCTRL_LINK_BAUD=6000000
#
# Off by default, and the default is not laziness. Without it an Input block
# reads the `default` its parameter declares, which is exactly what
# backend/src/exec.rs evaluates it to - so a plan carrying io blocks still
# grades bit-for-bit against the reference on a board with nothing wired to it.
# Turning this on is what makes the board's answer depend on another board.
if(CTRL_LINK)
  target_include_directories(app PRIVATE ../link/src)
  target_sources(app PRIVATE
    src/ctrl_io_link.c
    ../link/src/link_dma.c
    ../link/src/link_frame.c
  )
  target_compile_definitions(app PRIVATE CTRL_LINK=1)
  message(STATUS "ctrl: link bound on ${LINK_UART} at ${CTRL_LINK_BAUD} baud")
else()
  target_sources(app PRIVATE src/ctrl_io_none.c)
  message(STATUS "ctrl: no channels bound; Input blocks read their defaults")
endif()

# The single most important flag in this project.
#
# GCC defaults to -ffp-contract=fast, which fuses `acc += a * b` into VFMA. The
# fused form does not round the intermediate product, so it is MORE accurate
# than backend/src/exec.rs - and therefore wrong, because the contract for this
# stage is bit-for-bit agreement with that file, not "close enough".
#
# This is not theoretical and it is not loud. Measured on the host harness
# 2026-09-06: contraction changes the trace digest on three of the four
# committed fixtures, while the worst-case error (4.1e-6 on 04-2nd-order-system)
# stays INSIDE the project's 5.8e-6 noise floor. A tolerance-based grading would
# have passed it. Rust does not contract; neither may we.
target_compile_options(app PRIVATE -ffp-contract=off -fno-fast-math)

# Run each control step with interrupts locked:
#   west build ... -- -DCTRL_IRQ_LOCK=y
#
# An attribution tool, not a default. The step is measured to take ~3960 cycles
# with a single ~3930-cycle outlier per run; locking interrupts says whether
# that outlier is an ISR landing inside the step or the step itself varying.
# Emit the trace as hex text instead of a binary frame:
#   west build ... -- -DCTRL_TRACE_TEXT=y
#
# The frame is 2.3x smaller on the wire (14 KB vs 33 KB for a 501-step run) and
# is the format the next transports will carry. Text stays available because it
# is readable in a terminal without a decoder, which matters when the question
# is "is the board saying anything at all".
if(CTRL_TRACE_TEXT)
  target_compile_definitions(app PRIVATE CTRL_TRACE_TEXT=1)
  message(STATUS "ctrl: trace emitted as hex text")
endif()

# Run steps back to back instead of on the plan's tick:
#   west build ... -- -DCTRL_FREE_RUN=y
#
# Every measurement taken before the timer existed was in this mode, and it is
# still the quick way to check the numbers: fixture 04 at its real 50 ms tick
# takes 25 s to run, against under a second free-running. It is not a control
# loop and does not pretend to be.
# Override the scheduling period, in nanoseconds:
#   west build ... -- -DCTRL_TICK_NS=10000
#
# Drives the loop at a rate other than the plan's own, which is how the
# missed-deadline path gets exercised: set a period shorter than a step and the
# overrun counter has to notice. The model's arithmetic is untouched, so the
# trace must still match the reference bit-for-bit.
if(CTRL_TICK_NS)
  target_compile_definitions(app PRIVATE CTRL_TICK_NS=${CTRL_TICK_NS}ULL)
  message(STATUS "ctrl: tick overridden to ${CTRL_TICK_NS} ns")
endif()

if(CTRL_FREE_RUN)
  target_compile_definitions(app PRIVATE CTRL_FREE_RUN=1)
  message(STATUS "ctrl: free-running, no timer")
endif()

# Stream the trace over the console as it is produced, instead of only dumping
# it at the end:
#   west build ... -- -DCTRL_STREAM=y [-DCTRL_STREAM_POLL_MS=5]
#
# The rows are the same ones the record-then-dump path emits afterwards - same
# format, same values - so the graded digest and the DCPT frame are unchanged.
# What changes is when they leave, which is what makes a live monitor possible.
#
# The emit happens in main(), never in the control thread. main is preemptible
# and the control thread is K_PRIO_COOP(0), so a console write here structurally
# cannot land inside a step. See .internal/specs/2026-09-10-live-monitor-design.md.
if(CTRL_STREAM)
  if(NOT CTRL_STREAM_POLL_MS)
    set(CTRL_STREAM_POLL_MS 5)
  endif()
  target_compile_definitions(app PRIVATE
    CTRL_STREAM=1 CTRL_STREAM_POLL_MS=${CTRL_STREAM_POLL_MS})
  message(STATUS "ctrl: streaming trace rows, draining every ${CTRL_STREAM_POLL_MS} ms")
endif()

if(CTRL_IRQ_LOCK)
  target_compile_definitions(app PRIVATE CTRL_IRQ_LOCK=1)
  message(STATUS "ctrl: control step runs with interrupts locked")
endif()
```

## prj.conf
```kconfig
# Hardware FPU. The control plan is f32 throughout; double precision is present
# on this part (fpu_dp=1, established by the bring-up probe) but unused.
CONFIG_FPU=y

# Cycle-accurate step timing. The bring-up probe drove the DWT registers
# directly and its own notes recommend against doing that here: this API is
# DWT-backed on Cortex-M but portable to cores whose DWT is laid out
# differently, and it is a supported interface rather than a poke at 0xE0001000.
CONFIG_TIMING_FUNCTIONS=y

# The trace buffer is ~68 KB of .bss and deliberately NOT in DTCM - see main.c.
CONFIG_MAIN_STACK_SIZE=2048

# Caches stay at their defaults (on). The probe measured them as free, but only
# for a DTCM-resident working set; this application is the first thing here with
# a cacheable one, which is exactly why caches-off.conf exists next to this file.

# The control step runs in its own thread and main() also touches floats, so the
# FPU has two users. Without this, Zephyr does not preserve the callee-saved FP
# registers (s16-s31) across a context switch and the two contexts silently
# corrupt each other - Cortex-M lazy stacking only covers s0-s15.
CONFIG_FPU_SHARING=y
```

## caches-off.conf
```kconfig
# A/B fragment: the same runtime with both L1 caches disabled.
#
#   VARIANT=caches-off EXTRA_CONF=caches-off.conf \
#     bash firmware/scripts/build.sh ctrl nucleo_f767zi -p always
#
# The bring-up probe found caches cost nothing, but its working set was entirely
# in DTCM, which is never cached - so that result says nothing about this
# application, whose trace buffer lives in ordinary SRAM. PROJECT_STATUS.md
# carries "re-run the cache A/B once the runtime touches sram0" as an open item;
# this fragment is the other half of that run.
#
# The trace digest must be identical either way. If it is not, the caches are
# not the cause - nothing here reads uninitialised or DMA'd memory - and the
# real bug is elsewhere. What may legitimately change is the timing.
CONFIG_ICACHE=n
CONFIG_DCACHE=n
```

## fast-tick.conf
```kconfig
# Kernel tick fast enough to schedule a control period shorter than one step.
#
# k_timer resolution is the kernel tick, so at the default 10 kHz the shortest
# period available is 100 us - comfortably longer than the ~19 us step, which
# means the missed-deadline path can never be reached. 100 kHz makes a 10 us
# period expressible, and 10 us is shorter than a step by design.
#
#   VARIANT=deadline EXTRA_CONF=fast-tick.conf \
#     bash firmware/scripts/build.sh ctrl nucleo_f767zi -p always -- -DCTRL_TICK_NS=10000
CONFIG_SYS_CLOCK_TICKS_PER_SEC=100000
```

## link.conf
```kconfig
# The control app talking over the MCU-to-MCU link.
#
# Pulled in by -DCTRL_LINK=y, which also swaps ctrl_io_none.c for
# ctrl_io_link.c and compiles firmware/link's transceiver into this build.
# Without it the control core has no channels at all and an Input block reads
# its declared default - see src/ctrl_io_none.c.
#
# Everything here is the same set firmware/link/prj.conf carries and for the
# same reasons; that file is the one with the argument written out. The short
# version: the async API takes the receive deadline off the CPU, and the STM32
# driver refuses any DMA buffer it cannot prove non-cacheable, transmit
# included, so the ring lives in the MPU-backed nocache section rather than the
# D-cache being switched off.
CONFIG_SERIAL=y
CONFIG_UART_ASYNC_API=y
CONFIG_DMA=y
CONFIG_ARM_MPU=y
CONFIG_NOCACHE_MEMORY=y
```

## rtt.conf
```kconfig
# Console over SEGGER RTT, for the WeAct MiniSTM32H743.
#
#   EXTRA_CONF=rtt.conf bash firmware/scripts/build.sh ctrl mini_stm32h743 -p always
#
# The board's default console is USB CDC ACM, which loses everything printed
# before enumeration and puts a USB device stack on the control path - the two
# things this project keeps off it. The NUCLEO-F767ZI needs none of this: its
# console is a hardware UART.
#
# All three settings are load-bearing, and each cost a debugging session on the
# bring-up probe. firmware/BRINGUP.md has the full account.
CONFIG_USE_SEGGER_RTT=y
CONFIG_RTT_CONSOLE=y
CONFIG_UART_CONSOLE=n

# DTCM is never cached. Without this the Cortex-M7 D-cache holds the RTT writes
# and the debug probe, reading physical SRAM through the AHB-AP, sees a control
# block whose magic string is present but whose MaxNumUpBuffers reads 0.
CONFIG_SEGGER_RTT_SECTION_DTCM=y

# Big enough for a whole binary trace frame plus the surrounding text. A
# 501-step, 3-signal frame is 8060 bytes; 16 KB leaves room for wider plans.
# DTCM is 128 KB, so this is cheap.
CONFIG_SEGGER_RTT_BUFFER_SIZE_UP=16384
```

## boards/mini_stm32h743.overlay
```dts
/*
 * Select DTCM on the WeAct MiniSTM32H743.
 *
 * stm32h743.dtsi declares `dtcm: memory@20000000` (128 KB) but the board never
 * selects it, so without this the __dtcm_* linker sections do not exist and
 * runtime.c's pools have nowhere to go. nucleo_f767zi needs no equivalent: its
 * board .dts already has `zephyr,dtcm` in the chosen block.
 *
 * This duplicates firmware/bringup/boards/mini_stm32h743.overlay on purpose.
 * Zephyr discovers overlays under <app>/boards/, so each application needs its
 * own, and the content is a settled board fact rather than something that will
 * drift. See firmware/BRINGUP.md.
 */

/ {
	chosen {
		zephyr,dtcm = &dtcm;
	};
};
```

## src/main.c
```c
/*
 * ctrl-lab control runtime - stage D.
 *
 * Loads a Deployable Control Plan, arms it, runs it for the same number of
 * ticks as the committed reference trace, and prints the result in a form that
 * can be graded bit-for-bit against backend/src/exec.rs.
 *
 * This is the first thing in the project that executes a plan on hardware. What
 * it is NOT yet: driven by a hardware timer. The steps run back to back as fast
 * as the core manages, because stage D's question is "are the numbers right and
 * what does a step cost", not "can we hit a 1 kHz deadline". Wiring the tick to
 * a timer is the next step and needs the measurement below to size the budget.
 *
 * Grade a run with:
 *   firmware/scripts/console.ps1 > run.txt          (Windows, board attached)
 *   python3 firmware/scripts/grade-trace.py \
 *       test-projects/<plan>.f32.csv run.txt
 */

#include <zephyr/kernel.h>
#include <zephyr/devicetree.h>
#include <zephyr/drivers/uart.h>
#include <zephyr/sys/atomic.h>
#ifdef CONFIG_RTT_CONSOLE
#include <SEGGER_RTT.h>
#endif
#include <zephyr/sys/printk.h>
#include <zephyr/timing/timing.h>

#ifdef CTRL_LINK
#include "ctrl_io_link.h"
#endif
#include "dcp.h"
#include "kernels.h"
#include "plan_blob.h"
#include "runtime.h"
#include "trace.h"

#if !DT_HAS_CHOSEN(zephyr_dtcm)
#error "no zephyr,dtcm chosen - add an overlay for this board (see BRINGUP.md)"
#endif
#define DTCM_BASE DT_REG_ADDR(DT_CHOSEN(zephyr_dtcm))
#define DTCM_SIZE DT_REG_SIZE(DT_CHOSEN(zephyr_dtcm))

/* The recording buffers, deliberately in ordinary .bss rather than DTCM.
 *
 * The signal and state pools belong in DTCM because they are the hot path. This
 * does not: it is written once per tick and read only at the end, and putting a
 * ~68 KB buffer in a 128 KB DTCM would crowd out the thing that actually
 * benefits. It also gives the cache A/B something to measure for the first
 * time - see caches-off.conf.
 */
static float trace_signals[CTRL_PLAN_STEPS][CTRL_MAX_SIGNALS];
static float trace_times[CTRL_PLAN_STEPS];
static uint32_t step_cycles[CTRL_PLAN_STEPS];

static struct ctrl_plan plan;
static struct ctrl_runtime runtime;

/* Raw bytes to the console UART.
 *
 * printk cannot carry a binary frame - it formats - so the frame goes straight
 * at the device the console is already using. uart_poll_out is synchronous, so
 * it stays correctly ordered with the printk lines around it and needs no
 * interrupt handler of its own (which the control path is better off without).
 */
#ifndef CTRL_TRACE_TEXT
#ifdef CONFIG_RTT_CONSOLE

/* On an RTT console there is no UART to write to - the console is a ring buffer
 * in target RAM that the debug probe reads over SWD - so the frame goes at RTT
 * directly. It lands in DTCM (CONFIG_SEGGER_RTT_SECTION_DTCM) where it can be
 * read back with mem8, which is how the H743 is graded.
 */
static void trace_sink(void *ctx, const uint8_t *bytes, uint32_t len)
{
	ARG_UNUSED(ctx);
	SEGGER_RTT_Write(0, bytes, len);
}

#else
static const struct device *const console_uart = DEVICE_DT_GET(DT_CHOSEN(zephyr_console));

static void trace_sink(void *ctx, const uint8_t *bytes, uint32_t len)
{
	ARG_UNUSED(ctx);

	for (uint32_t i = 0; i < len; i++) {
		uart_poll_out(console_uart, bytes[i]);
	}
}
#endif /* CONFIG_RTT_CONSOLE */
#endif

static bool is_in_dtcm(const void *p)
{
	const uintptr_t a = (uintptr_t)p;

	return a >= DTCM_BASE && a < DTCM_BASE + DTCM_SIZE;
}

/* The integrity primitives decide whether a plan is executed at all, so they
 * are checked against known-answer vectors before the plan is trusted. A
 * miscompiled CRC that rejects every plan is obvious; one that ACCEPTS a
 * corrupt plan is not, and this is the cheap guard against it.
 */
static bool integrity_self_test(void)
{
	static const uint8_t vector[] = "123456789";
	const uint32_t crc = ctrl_crc32(vector, sizeof(vector) - 1);
	const uint64_t fnv = ctrl_fnv1a64(vector, sizeof(vector) - 1);
	const bool crc_ok = crc == 0xcbf43926U;
	const bool fnv_ok = fnv == 0x06d5573923c6cdfcULL;

	printk("crc32(\"123456789\")   = 0x%08x %s\n", crc, crc_ok ? "ok" : "*** WRONG ***");
	printk("fnv1a64(\"123456789\") = 0x%08x%08x %s\n", (uint32_t)(fnv >> 32), (uint32_t)fnv,
	       fnv_ok ? "ok" : "*** WRONG ***");

	return crc_ok && fnv_ok;
}

/* One control step, recorded and timed. Shared by both run modes so the thing
 * being measured is identical whether the tick comes from a timer or from the
 * top of a loop.
 *
 * The reference records the time BEFORE the step and the signals AFTER it
 * (exec.rs `run`), so row k is (k*ts, result of step k).
 */
static bool run_one_step(uint32_t k)
{
	const float *signals = ctrl_signals();

	trace_times[k] = ctrl_time(&runtime);

	/* Not const: timing_cycles_get() takes non-const pointers. */
#ifdef CTRL_IRQ_LOCK
	const unsigned int key = irq_lock();
#endif
	timing_t start = timing_counter_get();
	const bool ok = ctrl_step(&runtime);
	timing_t end = timing_counter_get();
#ifdef CTRL_IRQ_LOCK
	irq_unlock(key);
#endif

	step_cycles[k] = (uint32_t)timing_cycles_get(&start, &end);

	if (!ok) {
		printk("FAIL: fault at step %u, block %u: %s\n", k, runtime.fault_block,
		       ctrl_kernel_fault_str(runtime.fault));
		return false;
	}

	for (uint32_t slot = 0; slot < plan.signal_count; slot++) {
		trace_signals[k][slot] = signals[slot];
	}
	return true;
}

#if defined(CTRL_STREAM) && defined(CTRL_FREE_RUN)
#error "CTRL_STREAM needs the timer-driven runner: free-running has no separate \
control thread, so the emit would share a context with the step"
#endif

#ifdef CTRL_FREE_RUN

/* Steps back to back, as fast as the core manages. Not a control loop - this is
 * the mode every measurement before the timer landed was taken in, kept because
 * it answers "are the numbers right" in a second rather than in real time
 * (fixture 04 at its real 50 ms tick takes 25 s).
 */
static uint32_t run_plan(void)
{
	for (uint32_t k = 0; k < CTRL_PLAN_STEPS; k++) {
		if (!run_one_step(k)) {
			return k;
		}
	}
	return CTRL_PLAN_STEPS;
}

#else

/* Timer-driven: the plan's own base_ts_ns becomes the tick.
 *
 * The step runs in a dedicated cooperative thread woken by the timer, not in
 * the timer ISR itself. Two reasons, and the first is a correctness one:
 *
 *   - Floating point in an ISR needs CONFIG_FPU_SHARING, because without it the
 *     callee-saved FP registers (s16-s31) are not preserved and an ISR doing FP
 *     silently corrupts the interrupted thread's context. Cortex-M lazy stacking
 *     covers only s0-s15. A thread sidesteps the whole question.
 *   - firmware/AGENTS.md lists "high-priority Zephyr thread / ISR-triggered
 *     work" as the intended shape, and a cooperative priority means nothing
 *     short of an interrupt can preempt the step.
 *
 * The cost is one context switch of latency per tick, which is itself worth
 * measuring rather than assuming - the tick-to-tick figures below include it.
 */
#define CTRL_THREAD_STACK_SIZE 2048

K_THREAD_STACK_DEFINE(ctrl_thread_stack, CTRL_THREAD_STACK_SIZE);
static struct k_thread ctrl_thread;
static struct k_timer tick_timer;
static K_SEM_DEFINE(tick_signal, 0, 1);
static K_SEM_DEFINE(run_complete, 0, 1);

/* Ticks raised by the ISR, and ticks the thread actually serviced. They diverge
 * only if a step overran its period, which is the definition of a missed
 * deadline - so the difference is the measurement, not a bookkeeping detail.
 */
static atomic_t ticks_raised;
static uint32_t ticks_missed;
/* Written by the control thread, read by main()'s streaming drain loop. Without
 * volatile the load can be hoisted out of that loop and the stream stalls at
 * whatever value it happened to see first.
 */
static volatile uint32_t completed_steps;
static uint32_t tick_deltas[CTRL_PLAN_STEPS];
static uint32_t awake_deltas[CTRL_PLAN_STEPS];

static void tick_isr(struct k_timer *timer)
{
	ARG_UNUSED(timer);
	atomic_inc(&ticks_raised);
	k_sem_give(&tick_signal);
}

static void control_thread(void *a, void *b, void *c)
{
	ARG_UNUSED(a);
	ARG_UNUSED(b);
	ARG_UNUSED(c);

	uint32_t previous = k_cycle_get_32();
	timing_t previous_awake = timing_counter_get();
	uint32_t serviced = 0;

	while (completed_steps < CTRL_PLAN_STEPS) {
		k_sem_take(&tick_signal, K_FOREVER);

		/* The semaphore saturates at 1, so a tick raised while the
		 * previous step was still running is lost rather than queued.
		 * Comparing the ISR's count against our own is what makes that
		 * visible instead of silent.
		 */
		timing_t now_awake = timing_counter_get();
		const uint32_t raised = (uint32_t)atomic_get(&ticks_raised);

		serviced++;
		if (raised > serviced) {
			ticks_missed += raised - serviced;
			serviced = raised;
		}

		/* k_cycle_get_32(), NOT the DWT-backed timing API used for the step.
		 *
		 * Between ticks the core has nothing to run and Zephyr's idle thread
		 * executes WFI, which gates the core clock - and DWT CYCCNT counts
		 * core clock cycles, so it simply stops. Measuring the tick period
		 * with it reported ~11 900 cycles for a 50 ms period, which is not
		 * the period at all: it is the time the CPU was *awake*. The kernel
		 * cycle counter is driven by the system timer and keeps running
		 * across idle, so it can see the sleep.
		 *
		 * Both numbers are wanted, and they answer different questions:
		 * awake-cycles-per-tick is the CPU cost, this is the period.
		 */
		const uint32_t now = k_cycle_get_32();

		tick_deltas[completed_steps] = now - previous;
		awake_deltas[completed_steps] = (uint32_t)timing_cycles_get(&previous_awake, &now_awake);
		previous = now;
		previous_awake = now_awake;

		if (!run_one_step(completed_steps)) {
			break;
		}
		completed_steps++;
	}

	k_timer_stop(&tick_timer);
	k_sem_give(&run_complete);
}

#ifdef CTRL_STREAM
/* Emits the rows the control thread has appended since `from`, and returns the
 * new watermark.
 *
 * Called only from main(), which is preemptible while the control thread is
 * K_PRIO_COOP(0). That ordering is the whole safety argument: main cannot
 * preempt the step, so however long these printk calls take - and a row is
 * ~60 bytes, about 650 us at 921600 - they cannot land inside one. Emitting
 * from the control thread instead would put that write inside a 44 us step.
 */
static uint32_t stream_rows(uint32_t from)
{
	const uint32_t upto = completed_steps;

	for (uint32_t k = from; k < upto; k++) {
		printk("T,%08x", ctrl_f32_bits(trace_times[k]));
		for (uint32_t slot = 0; slot < plan.signal_count; slot++) {
			printk(",%08x", ctrl_f32_bits(trace_signals[k][slot]));
		}
		printk("\n");
	}
	return upto;
}
#endif /* CTRL_STREAM */

static uint32_t run_plan(void)
{
	k_timer_init(&tick_timer, tick_isr, NULL);

	k_thread_create(&ctrl_thread, ctrl_thread_stack, CTRL_THREAD_STACK_SIZE, control_thread,
			NULL, NULL, NULL, K_PRIO_COOP(0), 0, K_NO_WAIT);
	k_thread_name_set(&ctrl_thread, "control");

	/* CTRL_TICK_NS overrides the scheduling period ONLY. runtime.ts still comes
	 * from the plan, so the arithmetic is unchanged and the trace still has to
	 * match the reference - this drives the loop faster or slower than the model
	 * it is executing, which is exactly what is wanted to exercise the
	 * missed-deadline path.
	 */
#ifdef CTRL_TICK_NS
	const uint64_t tick_ns = CTRL_TICK_NS;

	printk("tick        %u ns (OVERRIDDEN; plan says %u ns), timer-driven\n",
	       (uint32_t)tick_ns, (uint32_t)plan.base_ts_ns);
#else
	const uint64_t tick_ns = plan.base_ts_ns;

	printk("tick        %u ns from the plan, timer-driven\n", (uint32_t)tick_ns);
#endif

	k_timer_start(&tick_timer, K_NSEC(tick_ns), K_NSEC(tick_ns));

#ifdef CTRL_STREAM
	/* Drain as it fills instead of waiting for the end. The rows are the same
	 * ones the record-then-dump path emits afterwards; what changes is only
	 * when they leave, so the graded digest and the DCPT frame are untouched.
	 */
	printk("\nstream_begin signals=%u\n", plan.signal_count);

	uint32_t streamed = 0;

	while (k_sem_take(&run_complete, K_MSEC(CTRL_STREAM_POLL_MS)) != 0) {
		streamed = stream_rows(streamed);
	}
	streamed = stream_rows(streamed);	/* whatever landed in the last window */

	printk("stream_end steps=%u\n", streamed);
#else
	k_sem_take(&run_complete, K_FOREVER);
#endif

	return completed_steps;
}

#endif /* CTRL_FREE_RUN */

int main(void)
{
	printk("\nctrl-lab control runtime (stage D)\n");
	printk("board " CONFIG_BOARD_TARGET ", SoC " CONFIG_SOC "\n");
	printk("icache=%d dcache=%d fpu_dp=%d\n", IS_ENABLED(CONFIG_ICACHE),
	       IS_ENABLED(CONFIG_DCACHE), IS_ENABLED(CONFIG_CPU_HAS_FPU_DOUBLE_PRECISION));
	printk("core %u Hz, kernel ticks %u Hz, irq_lock=%d\n",
	       sys_clock_hw_cycles_per_sec(), CONFIG_SYS_CLOCK_TICKS_PER_SEC,
	       IS_ENABLED(CTRL_IRQ_LOCK));
	printk("run mode    %s\n",
	       IS_ENABLED(CTRL_FREE_RUN) ? "free-running (no timer)" : "timer-driven");

	printk("signal_pool @ %p  %s\n", ctrl_signal_pool_addr(),
	       is_in_dtcm(ctrl_signal_pool_addr()) ? "in DTCM" : "*** NOT IN DTCM ***");
	printk("state_pool  @ %p  %s\n", ctrl_state_pool_addr(),
	       is_in_dtcm(ctrl_state_pool_addr()) ? "in DTCM" : "*** NOT IN DTCM ***");
	printk("trace_buf   @ %p  %s (expected: cacheable SRAM)\n", (void *)trace_signals,
	       is_in_dtcm(trace_signals) ? "in DTCM" : "not in DTCM");

	if (!integrity_self_test()) {
		printk("FAIL: integrity primitives are miscompiled, refusing to load\n");
		return 0;
	}

	const enum ctrl_load_result loaded =
		ctrl_plan_load(&plan, ctrl_plan_blob, sizeof(ctrl_plan_blob));

	printk("\nplan " CTRL_PLAN_NAME " (%u bytes): %s\n", (unsigned int)sizeof(ctrl_plan_blob),
	       ctrl_load_result_str(loaded));
	if (loaded != CTRL_LOAD_OK) {
		printk("FAIL: plan rejected\n");
		return 0;
	}

	printk("plan_id=0x%08x%08x format=%u kernels=%u\n", (uint32_t)(plan.plan_id >> 32),
	       (uint32_t)plan.plan_id, plan.format_version, plan.kernel_set_version);
	printk("base_ts_ns=%u blocks=%u signals=%u state=%u params=%u\n",
	       (uint32_t)plan.base_ts_ns, plan.n_blocks, plan.signal_count, plan.state_len,
	       plan.param_count);
	printk("wcet_estimate_ns=%u (0 = not yet stamped by the backend)\n",
	       (uint32_t)plan.wcet_estimate_ns);

	if (plan.signal_count > CTRL_MAX_SIGNALS) {
		printk("FAIL: more signals than the trace buffer holds\n");
		return 0;
	}

	timing_init();
	timing_start();

#ifdef CTRL_LINK
	/* Before arming, so an Input block never runs a tick against a link
	 * that is not listening. A plan with io_bindings on a board whose link
	 * failed to come up would read its defaults and produce a trace that
	 * looks fine and means nothing.
	 */
	if (!ctrl_io_link_init()) {
		printk("FAIL: link did not come up\n");
		return 0;
	}
	printk("link        bound, %u io_bindings\n", plan.n_io_bindings);
#else
	if (plan.n_io_bindings > 0) {
		printk("note        %u io_bindings, but no channels are bound in this\n"
		       "            build - every Input reads its declared default.\n"
		       "            Rebuild with -DCTRL_LINK=y to use the link.\n",
		       plan.n_io_bindings);
	}
#endif

	ctrl_arm(&runtime, &plan);

	const uint32_t completed = run_plan();

	uint64_t digest;

#ifdef CTRL_TRACE_TEXT
	struct ctrl_trace_hash hash;

	ctrl_trace_hash_init(&hash);

	printk("\ntrace_begin steps=%u signals=%u\n", completed, plan.signal_count);
	for (uint32_t k = 0; k < completed; k++) {
		printk("T,%08x", ctrl_f32_bits(trace_times[k]));
		ctrl_trace_hash_push(&hash, trace_times[k]);

		for (uint32_t slot = 0; slot < plan.signal_count; slot++) {
			printk(",%08x", ctrl_f32_bits(trace_signals[k][slot]));
			ctrl_trace_hash_push(&hash, trace_signals[k][slot]);
		}
		printk("\n");
	}
	printk("trace_end\n");
	digest = ctrl_trace_hash_value(&hash);
#else
	struct ctrl_trace_writer writer;

	/* The marker is for a human reading the console. The reader finds the
	 * frame by its magic and length, not by this line.
	 */
	printk("\ntrace_frame steps=%u signals=%u bytes=%u\n", completed, plan.signal_count,
	       (unsigned int)(CTRL_TRACE_HEADER_LEN +
			      completed * (1U + plan.signal_count) * 4U +
			      CTRL_TRACE_TRAILER_LEN));

	ctrl_trace_begin(&writer, trace_sink, NULL, plan.plan_id, (uint16_t)plan.signal_count,
			 completed);
	for (uint32_t k = 0; k < completed; k++) {
		ctrl_trace_row(&writer, trace_times[k], trace_signals[k]);
	}
	digest = ctrl_trace_end(&writer);
	printk("\n");
#endif
	printk("trace_fnv1a64=0x%08x%08x\n", (uint32_t)(digest >> 32), (uint32_t)digest);

	/* Step cost. `max` is the number that belongs in wcet_estimate_ns, and the
	 * spread is the jitter metric the project commits to reporting.
	 */
	uint32_t best = UINT32_MAX;
	uint32_t worst = 0;
	uint64_t total = 0;

	for (uint32_t k = 0; k < completed; k++) {
		best = MIN(best, step_cycles[k]);
		worst = MAX(worst, step_cycles[k]);
		total += step_cycles[k];
	}

	/* The first step is reported separately because it is not the same
	 * measurement as the rest: it runs with a cold I-cache and an untrained
	 * branch predictor, and it is the only step whose state pool has never been
	 * written. Folding it into `max` would report a startup cost as if it were
	 * the worst-case control step, which is exactly the number that later goes
	 * into wcet_estimate_ns.
	 */
	uint32_t steady_worst = 0;
	uint32_t worst_at = 0;
	uint32_t outliers = 0;

	for (uint32_t k = 1; k < completed; k++) {
		if (step_cycles[k] > steady_worst) {
			steady_worst = step_cycles[k];
			worst_at = k;
		}
		/* Anything half again as long as the fastest step did not simply run
		 * slowly - something interrupted it. Counting these separates "the
		 * kernel tick landed inside a step" from "the step itself is variable",
		 * which need completely different fixes.
		 */
		if (step_cycles[k] > best + best / 2U) {
			outliers++;
		}
	}

	if (completed > 0) {
		const uint32_t hz = sys_clock_hw_cycles_per_sec();
		const uint32_t mean = (uint32_t)(total / completed);

		printk("\nstep_cycles min=%u mean=%u max=%u spread=%u\n", best, mean, worst,
		       worst - best);
		printk("first_step  %u cycles; steady max=%u at step %u, jitter=%u (%u%%)\n",
		       step_cycles[0], steady_worst, worst_at, steady_worst - best,
		       steady_worst ? (steady_worst - best) * 100U / steady_worst : 0U);
		printk("outliers    %u of %u steps took >1.5x the fastest step\n", outliers,
		       completed - 1);

#ifndef CTRL_FREE_RUN
		/* Tick-to-tick, which is a different question from step cost: it
		 * measures when the step STARTED, so it includes timer accuracy
		 * and the wake-up latency of the control thread. This is the
		 * jitter figure the project commits to reporting.
		 */
#ifdef CTRL_TICK_NS
		const uint64_t nominal_ns = CTRL_TICK_NS;
#else
		const uint64_t nominal_ns = plan.base_ts_ns;
#endif
		const uint32_t expected = (uint32_t)(nominal_ns * hz / 1000000000U);
		uint32_t tick_best = UINT32_MAX;
		uint32_t tick_worst = 0;
		uint64_t tick_total = 0;

		/* Skip index 0: its "previous" timestamp is from before the timer
		 * started, so the first delta measures start-up, not a period.
		 */
		uint64_t awake_total = 0;
		uint32_t awake_worst = 0;

		for (uint32_t k = 1; k < completed; k++) {
			tick_best = MIN(tick_best, tick_deltas[k]);
			tick_worst = MAX(tick_worst, tick_deltas[k]);
			tick_total += tick_deltas[k];
			awake_worst = MAX(awake_worst, awake_deltas[k]);
			awake_total += awake_deltas[k];
		}

		if (completed > 1) {
			const uint32_t tick_mean = (uint32_t)(tick_total / (completed - 1));
			const uint32_t awake_mean = (uint32_t)(awake_total / (completed - 1));

			printk("tick_period min=%u mean=%u max=%u expected=%u cycles\n", tick_best,
			       tick_mean, tick_worst, expected);
			printk("tick_jitter %u cycles p-p (%u ns), mean is %d cycles off nominal\n",
			       tick_worst - tick_best,
			       (uint32_t)((uint64_t)(tick_worst - tick_best) * 1000000000U / hz),
			       (int32_t)(tick_mean - expected));

			/* Awake cycles per tick: the step plus the timer ISR, the
			 * semaphore and two context switches. The difference between
			 * this and the step alone is what the scheduling costs.
			 */
			printk("cpu_awake   mean=%u max=%u cycles per tick (step is %u of that)\n",
			       awake_mean, awake_worst, mean);
			/* Against the MEASURED period, not the requested one.
			 *
			 * k_timer resolution is one kernel tick, so a requested
			 * period is rounded UP to a whole tick - at the default
			 * 10 kHz, anything under 100 us silently becomes 100 us.
			 * Dividing by the request rather than the reality reports
			 * loads above 100% for a loop that is comfortably idle,
			 * which is exactly what it did before this line changed.
			 */
			printk("cpu_load    %u.%02u%% of the measured period is spent awake\n",
			       tick_mean ? awake_mean * 100U / tick_mean : 0U,
			       tick_mean ? (uint32_t)((uint64_t)awake_mean * 10000U / tick_mean) % 100U
					 : 0U);
			if (tick_mean > expected + expected / 100U) {
				printk("NOTE        requested %u ns but the timer delivered %u ns"
				       " - k_timer rounds up to a whole kernel tick\n",
				       (uint32_t)nominal_ns,
				       (uint32_t)((uint64_t)tick_mean * 1000000000U / hz));
			}
		}
		printk("deadlines   %u missed of %u ticks\n", ticks_missed, completed);
#endif
		printk("step_ns     min=%u mean=%u max=%u\n",
		       (uint32_t)((uint64_t)best * 1000000000U / hz),
		       (uint32_t)((uint64_t)mean * 1000000000U / hz),
		       (uint32_t)((uint64_t)worst * 1000000000U / hz));
		printk("budget      base_ts_ns=%u, so max step is %u%% of the period\n",
		       (uint32_t)plan.base_ts_ns,
		       (uint32_t)((uint64_t)worst * 1000000000U / hz * 100U /
				  (plan.base_ts_ns ? plan.base_ts_ns : 1)));
	}

#ifdef CTRL_LINK
	{
		struct ctrl_io_link_stats io;

		ctrl_io_link_stats(&io);
		printk("\nlink        took=%u held=%u empty=%u skipped=%u\n",
		       io.packets_taken, io.ticks_holding, io.ticks_without_packet,
		       io.packets_skipped);
		printk("            sent=%u dropped=%u\n", io.packets_sent,
		       io.packets_dropped);
	}
#endif

	printk("\ndone\n");

#ifdef CONFIG_RTT_CONSOLE
	/* Same reason as the bring-up probe: RTT is read over SWD, and letting
	 * Zephyr idle into WFI takes the H743's core domain off the debug bus,
	 * after which the board cannot be attached or reflashed without BOOT0 and
	 * a power cycle. See firmware/BRINGUP.md.
	 */
	printk("holding the CPU awake so RTT stays readable\n");
	while (1) {
		arch_nop();
	}
#endif

	return 0;
}
```

## src/ctrl_io.h
```c
/*
 * The hardware channel boundary.
 *
 * The control core knows nothing about peripherals; this is the whole of what
 * it may say to one. `runtime.c` calls these at the tick boundary - every read
 * before pass 1, every write between the passes - and nothing in `kernels.c`
 * calls them at all, which is what keeps the kernels pure and keeps two blocks
 * reading one channel in a tick from seeing two different samples.
 *
 * Two implementations exist:
 *
 *   host   returns false from every read and discards every write, so a plan
 *          carrying Input and Output still grades bit-for-bit against
 *          backend/src/exec.rs. A failed read leaves the Input's state word
 *          alone, and on the host that word never leaves its `default`.
 *   link   maps CTRL_CHANNEL_LINK onto the MCU-to-MCU link.
 *
 * A read that returns false is not an error the runtime reports. It means "no
 * fresh sample", and the Input holds its last good value - a zero-order hold,
 * which is what a control loop should do with a late packet and what the host
 * does with no link at all.
 */

#ifndef CTRL_IO_H
#define CTRL_IO_H

#include <stdbool.h>
#include <stdint.h>

/* The tick's edges, so an implementation can be transactional.
 *
 * Without these a channel would be sampled once per READ, and two Input blocks
 * on one channel could straddle the interrupt that publishes a new packet -
 * seeing two different samples inside a single tick. `begin` takes one snapshot
 * of everything inbound and every read for the rest of the tick is served from
 * it.
 *
 * `end` is the other half: writes accumulate, and this publishes them together.
 * A link that sent one packet per Output block would put two packets on the
 * wire for a two-channel plan and halve the rate it can sustain.
 *
 * The runtime calls `begin` before pass 1 and `end` between the passes. An
 * implementation with no channels leaves both empty.
 */
void ctrl_io_begin_tick(void);
void ctrl_io_end_tick(void);

/* `role` is an enum ctrl_channel_role; `index` is the channel within it. Both
 * come from a validated io_binding, so an implementation may assume the role is
 * one it advertises and need only bounds-check the index.
 */
bool ctrl_io_read(uint16_t role, uint16_t index, float *out);
bool ctrl_io_write(uint16_t role, uint16_t index, float value);

#endif /* CTRL_IO_H */
```

## src/ctrl_io_link.c
```c
/*
 * The control core's channels, carried over the MCU-to-MCU link.
 *
 * This is the file that finally connects `firmware/ctrl` to `firmware/link`,
 * and it is the only one in the control application that knows the link
 * exists. Everything above it sees `ctrl_io_read` and `ctrl_io_write`.
 *
 * The shape is set by one requirement: a tick's worth of I/O must be ONE
 * packet in each direction, sampled and published at one instant.
 *
 *   begin_tick   takes a single snapshot of the latched inbound packet. Every
 *                read for the rest of the tick is served from that copy, so two
 *                Input blocks on one channel cannot straddle the interrupt that
 *                publishes the next packet and see different samples.
 *   write        fills a slot in the outgoing packet. Nothing goes on the wire.
 *   end_tick     sends it, once. A packet per Output block would put two on the
 *                wire for a two-channel plan and halve the rate the link can
 *                sustain.
 *
 * Latency is why `end_tick` is called between the two passes rather than after
 * them - see runtime.c. The measured one-way cost of this link is about 89 us
 * against a 100 us tick (firmware/link/README.md), so a pass of scheduling is
 * not a rounding error here.
 */

#include <zephyr/kernel.h>
#include <zephyr/device.h>
#include <string.h>

#include "ctrl_io.h"
#include "ctrl_io_link.h"
#include "dcp.h"
#include "link_dma.h"
#include "link_pkt.h"

#define LINK_NODE DT_ALIAS(link_uart)
#if !DT_NODE_EXISTS(LINK_NODE)
#error "CTRL_LINK needs a link-uart alias - see firmware/link/boards/"
#endif

/* Without the async API this file compiles, links, and then fails at runtime on
 * a board that looks correctly configured. CMakeLists appends link.conf for
 * exactly this reason; the check is here as well because a build that loses the
 * fragment should stop rather than produce a deaf binary.
 */
#if !defined(CONFIG_UART_ASYNC_API)
#error "CTRL_LINK needs CONFIG_UART_ASYNC_API - see firmware/ctrl/link.conf"
#endif

static const struct device *const link_dev = DEVICE_DT_GET(LINK_NODE);

/* This tick's inbound packet, and whether one was ever latched. `fresh` says
 * the snapshot is new since last tick; without it a stalled link would serve
 * the same sample for ever and read as a working one.
 */
static struct ctrl_link_pkt inbound;
static bool inbound_valid;
static bool inbound_fresh;
static uint32_t inbound_last_seq;

/* This tick's outbound packet, and whether anything was written into it. */
static struct ctrl_link_pkt outbound;
static bool outbound_dirty;
static uint32_t outbound_seq;

/* Counted rather than reported: a control step cannot fail because a packet was
 * late, and the run's telemetry is where a starved link should show up. Read
 * them with ctrl_io_link_stats().
 */
static struct ctrl_io_link_stats stats;

bool ctrl_io_link_init(void)
{
	memset(&inbound, 0, sizeof(inbound));
	memset(&outbound, 0, sizeof(outbound));
	memset(&stats, 0, sizeof(stats));
	inbound_valid = false;
	inbound_fresh = false;
	outbound_dirty = false;
	outbound_seq = 0;

	return link_dma_init(link_dev);
}

void ctrl_io_begin_tick(void)
{
	struct ctrl_link_pkt latest;
	uint32_t rx_cycle;

	inbound_fresh = false;

	if (!link_dma_get_latest(&latest, &rx_cycle)) {
		stats.ticks_without_packet++;
		return;
	}

	/* The same packet as last tick is not a new sample. Saying so lets a
	 * held value be counted as a hold rather than silently pass for data.
	 */
	if (inbound_valid && latest.seq == inbound_last_seq) {
		stats.ticks_holding++;
		return;
	}

	if (inbound_valid) {
		const uint32_t gap = (uint32_t)(latest.seq - inbound_last_seq);

		if (gap > 1U) {
			stats.packets_skipped += gap - 1U;
		}
	}

	inbound = latest;
	inbound_last_seq = latest.seq;
	inbound_valid = true;
	inbound_fresh = true;
	stats.packets_taken++;
}

void ctrl_io_end_tick(void)
{
	if (!outbound_dirty) {
		return;
	}
	outbound_dirty = false;

	outbound.signal_count = CTRL_LINK_SIGNALS;
	outbound.seq = ++outbound_seq;
	outbound.tx_tick = (uint32_t)sys_clock_tick_get();

	if (link_dma_send(&outbound)) {
		stats.packets_sent++;
	} else {
		/* The previous transmit is still in flight, which at one packet
		 * per tick means the far side is not draining or the tick is
		 * faster than the link. The sample is dropped rather than
		 * queued: a control loop wants the newest value, not a backlog.
		 */
		stats.packets_dropped++;
	}
}

bool ctrl_io_read(uint16_t role, uint16_t index, float *out)
{
	if (role != CTRL_CHANNEL_LINK || index >= CTRL_LINK_SIGNALS) {
		return false;
	}
	if (!inbound_fresh) {
		/* No new sample. Writing nothing is what makes the Input block
		 * hold its last value - see ctrl_io.h.
		 */
		return false;
	}

	*out = inbound.signals[index];
	return true;
}

bool ctrl_io_write(uint16_t role, uint16_t index, float value)
{
	if (role != CTRL_CHANNEL_LINK || index >= CTRL_LINK_SIGNALS) {
		return false;
	}

	outbound.signals[index] = value;
	outbound_dirty = true;
	return true;
}

void ctrl_io_link_stats(struct ctrl_io_link_stats *out)
{
	*out = stats;
}
```

## src/ctrl_io_link.h
```c
/*
 * The link-backed implementation of ctrl_io.h, and the little it exposes
 * beyond that interface.
 *
 * Only main.c needs this: the HAL has to be brought up before a plan is armed,
 * and the run's report wants to say how the link behaved. The control core
 * itself sees nothing but ctrl_io.h.
 */

#ifndef CTRL_IO_LINK_H
#define CTRL_IO_LINK_H

#include <stdbool.h>
#include <stdint.h>

/* Per-tick outcomes, all free-running. None of these is an error the control
 * step reports - a late packet is a held sample, not a fault - so this is the
 * only place a starved link becomes visible.
 */
struct ctrl_io_link_stats {
	uint32_t packets_taken;		/* ticks that got a new inbound sample */
	uint32_t ticks_holding;		/* the latch held the same packet as last tick */
	uint32_t ticks_without_packet;	/* nothing latched at all */
	uint32_t packets_skipped;	/* seq gaps: samples that were never seen */
	uint32_t packets_sent;
	uint32_t packets_dropped;	/* a transmit was still in flight */
};

/* Arms the link. Must run before ctrl_arm(), and returns false loudly if the
 * UART or its DMA is not ready.
 */
bool ctrl_io_link_init(void);

void ctrl_io_link_stats(struct ctrl_io_link_stats *out);

#endif /* CTRL_IO_LINK_H */
```

## src/ctrl_io_none.c
```c
/*
 * No hardware channels on this build.
 *
 * The control app does not own a link yet: `firmware/link` does, and binding
 * the two is ctrl-lab-ri0.3. Until then a plan carrying Input and Output blocks
 * loads, arms and runs here, with every Input holding the `default` its
 * parameter declares.
 *
 * That is the same behaviour as the host harness, deliberately, so this build
 * and `firmware/ctrl/host` produce identical traces for the same plan. It is
 * also why this file is named for what it does rather than called a stub: a
 * board running it is not a board with a broken link, it is a board with no
 * link bound, and the loop it closes is the one through its own defaults.
 */

#include "ctrl_io.h"

void ctrl_io_begin_tick(void)
{
}

void ctrl_io_end_tick(void)
{
}

bool ctrl_io_read(uint16_t role, uint16_t index, float *out)
{
	(void)role;
	(void)index;
	(void)out;
	return false;
}

bool ctrl_io_write(uint16_t role, uint16_t index, float value)
{
	(void)role;
	(void)index;
	(void)value;
	return true;
}
```

## src/kernels.h
```c
/*
 * The kernel library: the runtime "ISA".
 *
 * Every kernel is pure, deterministic, allocation-free and bounded-WCET, and is
 * reached through a fixed dispatch table indexed by kernel_id. Adding a block
 * type is a new id plus a table entry plus a kernel_set_version bump - never an
 * engine change.
 *
 * `backend/src/exec.rs` is the executable specification for every function
 * here. Where the two could differ, exec.rs wins; the firmware is graded
 * against the traces it produces, to a 5.8e-6 f32 noise floor.
 */

#ifndef CTRL_KERNELS_H
#define CTRL_KERNELS_H

#include <stdint.h>

#include "dcp.h"

/* Largest transfer-function order the packed state space is trusted to run.
 *
 * Mirrors MAX_TF_ORDER in backend/src/exec.rs, where the number is measured
 * rather than chosen: a dense state space stores the expanded denominator, and
 * in f32 an order-3 clustered-pole filter already drifts ~100x past the project
 * noise floor while order 6 diverges outright.
 *
 * Do not raise this to run higher orders. The backend rejects them too, and the
 * documented path is a second-order-section cascade under a NEW kernel id.
 * Raising the constant trades a loud rejection for a quiet wrong answer.
 */
#define CTRL_MAX_TF_ORDER 2

/* What a kernel is given. Mirrors the kernel_ctx in firmware/AGENTS.md.
 *
 * `inputs` holds the gathered upstream signal *values*, in the kernel's declared
 * port order, so a kernel never touches the signal pool or a slot index.
 */
struct ctrl_kernel_ctx {
	const float *params;
	const float *inputs;
	float *state;
	uint16_t state_len;
	uint32_t tick;
	float time;
	float ts;
};

/* Pass 1 computes an output from state and inputs; pass 2 advances state.
 * Splitting them is not a style choice - see runtime.h on why one fused pass is
 * a different and wrong system.
 */
typedef float (*ctrl_kernel_output_fn)(const struct ctrl_kernel_ctx *ctx);
typedef void (*ctrl_kernel_update_fn)(const struct ctrl_kernel_ctx *ctx);

struct ctrl_kernel_desc {
	const char *name;
	ctrl_kernel_output_fn output;
	/* NULL for a stateless kernel: nothing to advance in pass 2. */
	ctrl_kernel_update_fn update;
	uint8_t in_count;
	/* Minimum packed parameter words. The transfer function needs more than
	 * this - its real requirement depends on the order in params[0] - and the
	 * loader checks that separately.
	 */
	uint8_t min_params;
};

/* A kernel that cannot produce a defined result raises a fault instead of
 * inventing one. exec.rs returns Err in the same places; the firmware cannot
 * unwind mid-tick, so the kernel sets a flag and the scheduler reads it after
 * the call - which is also how the block index gets attached, since a kernel
 * does not know its own position.
 */
enum ctrl_kernel_fault {
	CTRL_KERNEL_FAULT_NONE = 0,
	CTRL_KERNEL_FAULT_INVALID_SWITCH_SELECTOR,
};

void ctrl_kernel_fault_clear(void);
enum ctrl_kernel_fault ctrl_kernel_fault_get(void);
float ctrl_kernel_fault_value(void);
const char *ctrl_kernel_fault_str(enum ctrl_kernel_fault fault);

/* NULL for an id this firmware does not implement. */
const struct ctrl_kernel_desc *ctrl_kernel_desc(uint16_t kernel_id);

#endif /* CTRL_KERNELS_H */
```
